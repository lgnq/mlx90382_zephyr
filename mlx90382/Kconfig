## mlx90382/Kconfig
```kconfig
# Copyright (c) 2024 Florian Weber <Florian.Weber@live.de>
# SPDX-License-Identifier: Apache-2.0


config MLX90382
	bool "MLX90382 Magnetic Encoder"
	default y
	depends on DT_HAS_MELEXIS_MLX90382_ENABLED
	select SPI
	help
	  Enable driver for MLX90382 Magnetic Encoder.
```
